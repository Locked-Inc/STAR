## esp32-firmware/components/star_bus/Kconfig
```kconfig
# esp32-firmware/components/star_bus/Kconfig

menu "STAR Bus Configuration"

config STAR_KCONFIG_BUS_MUTEX_TIMEOUT_MS
    int "Bus manager mutex timeout (milliseconds)"
    default 1000
    range 100 10000
    help
        Timeout in milliseconds for acquiring bus manager mutex.
        Default is 1000ms (1 second). Increase if you experience
        timeout errors in high-load scenarios.

endmenu
```

## esp32-firmware/test_app/main/Kconfig.projbuild
```kconfig
# esp32-firmware/test_app/main/Kconfig.projbuild

menu "Test App Configuration"

    menu "WiFi Configuration"

        config PYNQ_WIFI_SSID
            string "WiFi SSID"
            default "myssid"
            help
                WiFi network name (SSID) to connect to

        config PYNQ_WIFI_PASSWORD
            string "WiFi Password"
            default "mypassword"
            help
                WiFi network password

        config PYNQ_WIFI_MAXIMUM_RETRY
            int "Maximum WiFi Retry Attempts"
            default 5
            help
                Maximum number of retry attempts when connecting to WiFi

    endmenu

endmenu
```

## old-firmware/main/Kconfig.projbuild
```kconfig
# esp32-firmware/main/Kconfig.projbuild

menu "PYNQ WiFi Bridge Configuration"

    choice PYNQ_BOARD_TYPE
        prompt "Board Type"
        default PYNQ_BOARD_ESP32_WROOM_32
        help
            Select the ESP32 board type for pin defaults and optimizations.
            This automatically configures the correct partition table:
            - ESP32-WROOM-32: 4MB flash, 900KB OTA partitions
            - ESP32-S3-WROOM-1-N16: 16MB flash, 2MB OTA partitions + 8MB SPIFFS

        config PYNQ_BOARD_ESP32_WROOM_32
            bool "ESP32-WROOM-32 (4MB flash)"
            help
                Current development board (ESP32-WROOM-32)
                - 4 MB flash
                - OTA partitions: 900 KB each
                - Suitable for testing and development

        config PYNQ_BOARD_ESP32_S3_WROOM_1_N16
            bool "ESP32-S3-WROOM-1-N16 (16MB flash)"
            help
                Future production board (ESP32-S3-WROOM-1-N16)
                - 16 MB flash + 8 MB PSRAM
                - OTA partitions: 2 MB each
                - SPIFFS: 8 MB for logs/data
                - Coredump: 64 KB for debugging
    endchoice

    config PYNQ_CUSTOM_PARTITION_TABLE_PATH
        string
        default "partitions_ota_4mb.csv" if PYNQ_BOARD_ESP32_WROOM_32
        default "partitions_ota_16mb.csv" if PYNQ_BOARD_ESP32_S3_WROOM_1_N16

    choice PYNQ_TRANSPORT_MODE
        prompt "Transport Mode"
        default PYNQ_TRANSPORT_UART
        help
            Select communication method with PYNQ-Z2.
            UART: For testing and development
            SPI: For production use (ESP32 as SPI slave)

        config PYNQ_TRANSPORT_UART
            bool "UART"
            help
                Use UART for communication (testing/development)

        config PYNQ_TRANSPORT_SPI
            bool "SPI Slave"
            help
                Use SPI slave mode for communication (production)
    endchoice

    menu "UART Configuration"
        depends on PYNQ_TRANSPORT_UART

        config PYNQ_UART_TX_GPIO
            int "UART TX GPIO"
            default 17 if PYNQ_BOARD_ESP32_WROOM_32
            default 43 if PYNQ_BOARD_ESP32_S3_WROOM_1_N16
            range 0 39 if PYNQ_BOARD_ESP32_WROOM_32
            range 0 48 if PYNQ_BOARD_ESP32_S3_WROOM_1_N16
            help
                GPIO pin for UART TX (transmit to PYNQ-Z2)
                ESP32-WROOM-32: GPIO17
                ESP32-S3-WROOM-1-N16: GPIO43 (TXD0)

        config PYNQ_UART_RX_GPIO
            int "UART RX GPIO"
            default 16 if PYNQ_BOARD_ESP32_WROOM_32
            default 44 if PYNQ_BOARD_ESP32_S3_WROOM_1_N16
            range 0 39 if PYNQ_BOARD_ESP32_WROOM_32
            range 0 48 if PYNQ_BOARD_ESP32_S3_WROOM_1_N16
            help
                GPIO pin for UART RX (receive from PYNQ-Z2)
                ESP32-WROOM-32: GPIO16
                ESP32-S3-WROOM-1-N16: GPIO44 (RXD0)

        config PYNQ_UART_BAUD_RATE
            int "UART Baud Rate"
            default 115200
            help
                UART baud rate for communication

    endmenu

    menu "SPI Configuration"
        depends on PYNQ_TRANSPORT_SPI

        config PYNQ_SPI_MOSI_GPIO
            int "SPI MOSI GPIO"
            default 13 if PYNQ_BOARD_ESP32_WROOM_32
            default 11 if PYNQ_BOARD_ESP32_S3_WROOM_1_N16
            range 0 39 if PYNQ_BOARD_ESP32_WROOM_32
            range 0 48 if PYNQ_BOARD_ESP32_S3_WROOM_1_N16
            help
                GPIO pin for SPI MOSI (Master Out Slave In - PYNQ to ESP32)
                ESP32-WROOM-32: GPIO13
                ESP32-S3-WROOM-1-N16: IO11

        config PYNQ_SPI_MISO_GPIO
            int "SPI MISO GPIO"
            default 12 if PYNQ_BOARD_ESP32_WROOM_32
            default 13 if PYNQ_BOARD_ESP32_S3_WROOM_1_N16
            range 0 39 if PYNQ_BOARD_ESP32_WROOM_32
            range 0 48 if PYNQ_BOARD_ESP32_S3_WROOM_1_N16
            help
                GPIO pin for SPI MISO (Master In Slave Out - ESP32 to PYNQ)
                ESP32-WROOM-32: GPIO12
                ESP32-S3-WROOM-1-N16: IO13

        config PYNQ_SPI_CLK_GPIO
            int "SPI CLK GPIO"
            default 14 if PYNQ_BOARD_ESP32_WROOM_32
            default 12 if PYNQ_BOARD_ESP32_S3_WROOM_1_N16
            range 0 39 if PYNQ_BOARD_ESP32_WROOM_32
            range 0 48 if PYNQ_BOARD_ESP32_S3_WROOM_1_N16
            help
                GPIO pin for SPI CLK (Clock from PYNQ)
                ESP32-WROOM-32: GPIO14
                ESP32-S3-WROOM-1-N16: IO12 (SCLK)

        config PYNQ_SPI_CS_GPIO
            int "SPI CS GPIO"
            default 15 if PYNQ_BOARD_ESP32_WROOM_32
            default 10 if PYNQ_BOARD_ESP32_S3_WROOM_1_N16
            range 0 39 if PYNQ_BOARD_ESP32_WROOM_32
            range 0 48 if PYNQ_BOARD_ESP32_S3_WROOM_1_N16
            help
                GPIO pin for SPI CS (Chip Select from PYNQ)
                ESP32-WROOM-32: GPIO15
                ESP32-S3-WROOM-1-N16: IO10 (CS)

        config PYNQ_SPI_CLOCK_SPEED_HZ
            int "SPI Clock Speed (Hz)"
            default 1000000
            range 100000 10000000
            help
                SPI clock frequency in Hz (max 10MHz for reliable operation)

    endmenu

    menu "WiFi Configuration"

        config PYNQ_WIFI_SSID
            string "WiFi SSID"
            default "myssid"
            help
                WiFi network name (SSID) to connect to

        config PYNQ_WIFI_PASSWORD
            string "WiFi Password"
            default "mypassword"
            help
                WiFi network password

        config PYNQ_WIFI_MAXIMUM_RETRY
            int "Maximum WiFi Retry Attempts"
            default 5
            help
                Maximum number of retry attempts when connecting to WiFi

    endmenu

    menu "OTA Update Configuration"

        config PYNQ_OTA_UPDATE_URL
            string "OTA Update URL"
            default "https://robot-backend.com/api/esp32/firmware.bin"
            help
                URL to download firmware updates from.
                This should point to your backend server's firmware endpoint.
                Example: https://robot-backend.com/api/esp32/firmware.bin

        config PYNQ_OTA_VERSION_CHECK_URL
            string "OTA Version Check URL"
            default "https://robot-backend.com/api/esp32/version"
            help
                URL to check for firmware version information.
                Server should return JSON with: version, url, min_version, changelog
                Example: https://robot-backend.com/api/esp32/version

        config PYNQ_OTA_AUTO_UPDATE
            bool "Enable Automatic OTA Updates"
            default n
            help
                If enabled, ESP32 will automatically check for and install updates.
                If disabled (default), updates must be triggered manually via PYNQ.

        config PYNQ_OTA_CHECK_INTERVAL_MS
            int "OTA Update Check Interval (milliseconds)"
            default 3600000
            range 60000 86400000
            depends on PYNQ_OTA_AUTO_UPDATE
            help
                How often to check for firmware updates (in milliseconds).
                Default: 3600000 (1 hour)
                Min: 60000 (1 minute)
                Max: 86400000 (24 hours)

        config PYNQ_OTA_AUTO_REBOOT
            bool "Automatically Reboot After Update"
            default y
            help
                If enabled, ESP32 will automatically reboot after a successful update.
                If disabled, reboot must be triggered manually.

        config PYNQ_OTA_HTTPS_CERT_VERIFICATION
            bool "Enable HTTPS Certificate Verification"
            default n
            help
                If enabled, OTA downloads will verify the server's TLS certificate.
                Requires a valid CA certificate to be embedded in the firmware.
                Disable for testing with self-signed certificates or HTTP servers.

    endmenu

endmenu
```

## old-firmware/test_app/sdkconfig.defaults
```kconfig
# test_app/sdkconfig.defaults
#
# Default configuration for test application

# Enable Unity test framework
CONFIG_UNITY_ENABLE_FLOAT=y
CONFIG_UNITY_ENABLE_DOUBLE=y
CONFIG_UNITY_ENABLE_64BIT=y
CONFIG_UNITY_ENABLE_COLOR=y

# Enable FreeRTOS for testing
CONFIG_FREERTOS_HZ=1000

# Logging
CONFIG_LOG_DEFAULT_LEVEL_INFO=y
CONFIG_LOG_COLORS=y

# Increase main task stack for tests
CONFIG_ESP_MAIN_TASK_STACK_SIZE=8192

# Enable assertions for testing
CONFIG_COMPILER_OPTIMIZATION_ASSERTIONS_ENABLE=y

# Memory debugging
CONFIG_HEAP_POISONING_COMPREHENSIVE=y
CONFIG_HEAP_TRACING_STANDALONE=y
```

## star-pi5-os/configs/rpi5_64_defconfig
```kconfig
# STAR Robot OS - Raspberry Pi 5 64-bit Configuration
# Based on official raspberrypi5_defconfig from Buildroot 2025.02

# Architecture
BR2_aarch64=y
BR2_cortex_a76=y
BR2_PACKAGE_HOST_LINUX_HEADERS_CUSTOM_6_6=y

# Toolchain
BR2_TOOLCHAIN_BUILDROOT_GLIBC=y
BR2_TOOLCHAIN_BUILDROOT_CXX=y

# Global settings
BR2_GLOBAL_PATCH_DIR="board/raspberrypi/patches"
BR2_DOWNLOAD_FORCE_CHECK_HASHES=y

# System
BR2_INIT_SYSTEMD=y
BR2_SYSTEM_DHCP="eth0"
BR2_TARGET_GENERIC_HOSTNAME="star-robot"
BR2_TARGET_GENERIC_ISSUE="Welcome to STAR Robot OS"
BR2_ROOTFS_OVERLAY="$(BR2_EXTERNAL_STAR_ROBOT_PATH)/overlays"
BR2_ROOTFS_POST_BUILD_SCRIPT="board/raspberrypi5/post-build.sh"
BR2_ROOTFS_POST_IMAGE_SCRIPT="$(BR2_EXTERNAL_STAR_ROBOT_PATH)/scripts/post-image.sh"

# Kernel
BR2_LINUX_KERNEL=y
BR2_LINUX_KERNEL_CUSTOM_TARBALL=y
BR2_LINUX_KERNEL_CUSTOM_TARBALL_LOCATION="$(call github,raspberrypi,linux,576cc10e1ed50a9eacffc7a05c796051d7343ea4)/linux-576cc10e1ed50a9eacffc7a05c796051d7343ea4.tar.gz"
BR2_LINUX_KERNEL_DEFCONFIG="bcm2712"
BR2_LINUX_KERNEL_CONFIG_FRAGMENT_FILES="board/raspberrypi/linux-4k-page-size.fragment"
BR2_LINUX_KERNEL_DTS_SUPPORT=y
BR2_LINUX_KERNEL_INTREE_DTS_NAME="broadcom/bcm2712-rpi-5-b broadcom/bcm2712d0-rpi-5-b"
BR2_LINUX_KERNEL_NEEDS_HOST_OPENSSL=y

# Bootloader
BR2_PACKAGE_RPI_FIRMWARE=y
BR2_PACKAGE_RPI_FIRMWARE_CONFIG_FILE="$(BR2_EXTERNAL_STAR_ROBOT_PATH)/configs/config.txt"
BR2_PACKAGE_RPI_FIRMWARE_CMDLINE_FILE="board/raspberrypi5/cmdline_5.txt"
# BR2_PACKAGE_RPI_FIRMWARE_INSTALL_DTB_OVERLAYS is not set

# Filesystem
BR2_TARGET_ROOTFS_EXT2=y
BR2_TARGET_ROOTFS_EXT2_4=y
BR2_TARGET_ROOTFS_EXT2_SIZE="2G"
# BR2_TARGET_ROOTFS_TAR is not set

# System tools
BR2_PACKAGE_BUSYBOX_SHOW_OTHERS=y
BR2_PACKAGE_BUSYBOX_CONFIG="$(BR2_EXTERNAL_STAR_ROBOT_PATH)/configs/busybox.config"
BR2_PACKAGE_XZ=y
BR2_PACKAGE_KMOD=y
BR2_PACKAGE_KMOD_TOOLS=y

# Network
BR2_PACKAGE_DHCPCD=y
BR2_PACKAGE_OPENSSH=y

# WiFi Support
BR2_PACKAGE_WPA_SUPPLICANT=y
BR2_PACKAGE_WPA_SUPPLICANT_CLI=y
BR2_PACKAGE_WPA_SUPPLICANT_WPA_CLIENT_SO=y
BR2_PACKAGE_WIRELESS_TOOLS=y
BR2_PACKAGE_IW=y

# mDNS Service Discovery
BR2_PACKAGE_AVAHI=y
BR2_PACKAGE_AVAHI_DAEMON=y
BR2_PACKAGE_DBUS=y

# Java - OpenJDK 17 (LTS)
BR2_PACKAGE_OPENJDK=y
BR2_PACKAGE_OPENJDK_FULL=y

# Python 3 (required for ROS2)
BR2_PACKAGE_PYTHON3=y
BR2_PACKAGE_PYTHON3_PY_PYC=y

# Python ML/Scientific Libraries
BR2_PACKAGE_PYTHON_NUMPY=y
BR2_PACKAGE_PYTHON_SCIPY=y
BR2_PACKAGE_PYTHON_PILLOW=y

# Camera Support
BR2_PACKAGE_LIBCAMERA=y
BR2_PACKAGE_V4L_UTILS=y

# Computer Vision & ML
BR2_PACKAGE_OPENCV4=y
BR2_PACKAGE_OPENCV4_LIB_PYTHON=y
BR2_PACKAGE_OPENCV4_WITH_JPEG=y
BR2_PACKAGE_OPENCV4_WITH_PNG=y
BR2_PACKAGE_OPENCV4_WITH_TIFF=y

# ROS2 Jazzy
BR2_PACKAGE_ROS2_JAZZY=y

# Development tools (needed for ROS2 workspace builds)
BR2_PACKAGE_GCC_TARGET=y
BR2_PACKAGE_BINUTILS_TARGET=y
BR2_PACKAGE_MAKE=y
BR2_PACKAGE_CMAKE=y
BR2_PACKAGE_PKGCONF=y
BR2_PACKAGE_GIT=y
BR2_PACKAGE_WGET=y
BR2_PACKAGE_PATCH=y
BR2_PACKAGE_DIFFUTILS=y

# Host tools
BR2_PACKAGE_HOST_DOSFSTOOLS=y
BR2_PACKAGE_HOST_GENIMAGE=y
BR2_PACKAGE_HOST_KMOD_XZ=y
BR2_PACKAGE_HOST_MTOOLS=y
```

## star-pi5-os/package/ros2-jazzy/Config.in
```kconfig
config BR2_PACKAGE_ROS2_JAZZY
	bool "ros2-jazzy"
	depends on BR2_PACKAGE_PYTHON3
	depends on BR2_TOOLCHAIN_GCC_AT_LEAST_9
	select BR2_PACKAGE_PYTHON3_PY_PYC
	select BR2_PACKAGE_PYTHON3_PIP
	select BR2_PACKAGE_PYTHON3_SETUPTOOLS
	select BR2_PACKAGE_PYTHON_NUMPY
	select BR2_PACKAGE_EIGEN
	select BR2_PACKAGE_LIBCURL
	select BR2_PACKAGE_YAML_CPP
	select BR2_PACKAGE_LIBYAML
	select BR2_PACKAGE_SQLITE
	select BR2_PACKAGE_LTTNG_LIBUST
	select BR2_PACKAGE_LTTNG_TOOLS
	help
	  ROS2 Jazzy (Robot Operating System 2) - Latest LTS release
	  Pre-built binaries for ARM64 architecture.

	  https://docs.ros.org/en/jazzy/

comment "ros2-jazzy needs Python3 and a toolchain w/ gcc >= 9"
	depends on !BR2_PACKAGE_PYTHON3 || !BR2_TOOLCHAIN_GCC_AT_LEAST_9
```

## star-rpi5-buildroot/package/cyclonedds/Config.in
```kconfig
config BR2_PACKAGE_CYCLONEDDS
	bool "cyclonedds"
	depends on BR2_INSTALL_LIBSTDCPP
	depends on BR2_TOOLCHAIN_HAS_THREADS
	help
	  Eclipse Cyclone DDS is a very performant and robust
	  open-source DDS implementation.

	  https://github.com/eclipse-cyclonedds/cyclonedds

comment "cyclonedds needs a toolchain w/ C++, threads"
	depends on !BR2_INSTALL_LIBSTDCPP || !BR2_TOOLCHAIN_HAS_THREADS
```

## star-yocto-config/conf/bblayers.conf
```bitbake
# POKY_BBLAYERS_CONF_VERSION is increased each time build/conf/bblayers.conf
# changes incompatibly
POKY_BBLAYERS_CONF_VERSION = "2"

BBPATH = "${TOPDIR}"
BBFILES ?= ""

BBLAYERS ?= " \
  /home/brighton/STAR/star-yocto/poky/meta \
  /home/brighton/STAR/star-yocto/poky/meta-poky \
  /home/brighton/STAR/star-yocto/poky/meta-yocto-bsp \
  /home/brighton/STAR/star-yocto/meta-raspberrypi \
  /home/brighton/STAR/star-yocto/meta-openembedded/meta-oe \
  /home/brighton/STAR/star-yocto/meta-openembedded/meta-python \
  /home/brighton/STAR/star-yocto/meta-openembedded/meta-networking \
  /home/brighton/STAR/star-yocto/meta-openembedded/meta-multimedia \
  /home/brighton/STAR/star-yocto/meta-ros/meta-ros-common \
  /home/brighton/STAR/star-yocto/meta-ros/meta-ros2 \
  /home/brighton/STAR/star-yocto/meta-ros/meta-ros2-jazzy \
  /home/brighton/STAR/star-yocto/meta-star \
  "
```

## star-yocto-config/meta-star/conf/layer.conf
```bitbake
BBPATH .= ":${LAYERDIR}"
BBFILES += "${LAYERDIR}/recipes-*/*/*.bb"
BBFILE_COLLECTIONS += "meta-star"
BBFILE_PATTERN_meta-star = "^${LAYERDIR}/"
LAYERSERIES_COMPAT_meta-star = "scarthgap"
```
