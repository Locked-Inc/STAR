## yocto-build/configs/pynqz2-robot-sdimage.wks
```
# PYNQ-Z2 Robot System SD Card Image Layout
# This file defines the partitioning scheme for the SD card image

# Partition 1: Boot partition (FAT32, ~100MB)
# Contains bootloader, kernel, device tree, and FPGA bitstream
part /boot --source bootimg-partition --ondisk mmcblk0 --fstype=vfat --label boot --active --align 4 --size 100M --extra-space 0

# Partition 2: Root filesystem (ext4, remaining space)
# Contains the complete Linux root filesystem with robot software
part / --source rootfs --ondisk mmcblk0 --fstype=ext4 --label root --align 4 --extra-space 500M

# Bootloader configuration in MBR
bootloader --ptable msdos --append="console=ttyPS0,115200 earlyprintk root=/dev/mmcblk0p2 rw rootfstype=ext4 rootwait"

# SD card image format
# This creates a .wic file that can be directly written to SD card
```

## yocto-build/layers/downloaded/meta-pynq/conf/layer.conf
```bitbake
# PYNQ Meta Layer Configuration
BBPATH .= ":${LAYERDIR}"

BBFILES += "${LAYERDIR}/recipes-*/*/*.bb \
            ${LAYERDIR}/recipes-*/*/*.bbappend"

BBFILE_COLLECTIONS += "meta-pynq"
BBFILE_PATTERN_meta-pynq = "^${LAYERDIR}/"
BBFILE_PRIORITY_meta-pynq = "7"

LAYERNAME = "meta-pynq"
LAYERSERIES_COMPAT_meta-pynq = "kirkstone"
```

## yocto-build/layers/meta-robot-slam/conf/layer.conf
```bitbake
# Meta Robot SLAM Layer Configuration
# Custom layer for PYNQ-Z2 LiDAR SLAM and Computer Vision robot system

# Layer path
BBPATH .= ":${LAYERDIR}"

# Recipe patterns
BBFILES += "${LAYERDIR}/recipes-*/*/*.bb \
            ${LAYERDIR}/recipes-*/*/*.bbappend"

# Layer identification
BBFILE_COLLECTIONS += "meta-robot-slam"
BBFILE_PATTERN_meta-robot-slam = "^${LAYERDIR}/"
BBFILE_PRIORITY_meta-robot-slam = "10"

# Layer information
LAYERNAME = "meta-robot-slam"
LAYERDEPENDS_meta-robot-slam = " \
    core \
    openembedded-layer \
    meta-python \
"

# Compatible releases
LAYERSERIES_COMPAT_meta-robot-slam = "kirkstone"

# Layer description
LAYERDESC = "Custom layer for PYNQ-Z2 based LiDAR SLAM and Computer Vision robot system"

# Additional paths
BBFILES += "${LAYERDIR}/recipes-*/*/*/*.bb"
BBFILES += "${LAYERDIR}/recipes-*/*/*/*.bbappend"
```
